## components/mqtt_manager/Kconfig.projbuild
```kconfig
menu "MQTT Manager Configuration"

    config LOGGING_TAG
        string "Logging TAG"
        default "MQTT_MANAGER"
        help
            The TAG string that identifies the running logging system.

    config BROKER_URL
        string "Broker URL"
        default "mqtt://broker.mqttdashboard.com"
        help
            URL of the broker to connect to

endmenu
```

## main/Kconfig.projbuild.sample
```kconfig
menu "Mesh Network Configuration"

    config DEVICE_VERSION
        string "Device version"
        default "0.0.1"
        help
            Config device version

    choice DEVICE_TYPE
        bool "Configure the device type"
        default DEVICE_TYPE_NODE
        help
            Configure the device type
        config DEVICE_TYPE_IDLE
            bool "IDLE device"
        config DEVICE_TYPE_ROOT
            bool "Root device"
        config DEVICE_TYPE_NODE
            bool "Non-Root device"
        config DEVICE_TYPE_LEAF
            bool "Leaf device"
    endchoice
    config DEVICE_TYPE
        int
        default 0 if DEVICE_TYPE_IDLE
        default 1 if DEVICE_TYPE_ROOT
        default 2 if DEVICE_TYPE_NODE
        default 3 if DEVICE_TYPE_LEAF

    config MESH_ID
        string "Mesh ID"
        default "lcarnevale-mesh"
        help
            Mesh network identification, Nodes with the same mesh 
            ID can communicate with each other.

    config MESH_CHANNEL
        int "Mesh network channel"
        range 1 14
        default 13
        help
            Mesh network channel.
    
    config LED_GPIO
        int "LED GPIO number"
        range 0 48
        default 2
        help
            GPIO number (IOxx) to blink on and off.

    config ROUTER_SSID
        string "Router SSID"
        default "MartinRouterKingGuest"
        help
            Router SSID.

    config ROUTER_PASSWORD
        string "Router password"
        default "amezzanottesaicheiotitrovero!"
        help
            Router password.
 
    config FIRMWARE_UPGRADE_URL
        string "Firmware upgrade url endpoint"
        default "https://192.168.1.20:8070/mupgrade.bin"
        help
            URL of server which hosts the firmware image.

endmenu
```
